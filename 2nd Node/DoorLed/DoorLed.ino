#include <Servo.h>
Servo myservo;

#include <ESP8266WiFi.h>
#include <WiFiClientSecureAxTLS.h> //กรณีข้ึน Error ใหเ้อาบรรทดัน้ีออก
// Config connect WiFi
#define WIFI_SSID "Admin-Wifi-2.4GHz"
#define WIFI_PASSWORD "seam2448860"
// Line config
#define LINE_TOKEN "9dm1RQ7McZiavFOWLodg8ihFMUcwwTkBwc5kwPtP84X"

String message = "Please Open The Door!!";


int banana = 0;
int i = 0;
int R0nad = 0;

#include <Wire.h>
#include <SH1106.h>

SH1106 display(0x3c, D1, D2);

#define width 64
#define height 64
#define TRIG_PIN D7
#define ECHO_PIN D6 
#define led D0
#define sw D5

unsigned long previousTime = 0;
int Start = 0;
int setTime = 5;
int r0und = 0;
int pos = 90;

static unsigned char BT[] = {
  0x00, 0x00, 0x00, 0x00, 0x00, 0x00, 0x00, 0x00, 0x00, 0x00, 0x00, 0x00, 
  0x00, 0x00, 0x00, 0x00, 0x00, 0x00, 0x00, 0x00, 0x00, 0x00, 0x00, 0x00, 
  0x00, 0x00, 0x00, 0x00, 0x00, 0x00, 0x00, 0x00, 0x00, 0x00, 0x00, 0x00, 
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  0x00, 0x00, 0x00, 0x00, 0x00, 0x00, 0x00, 0x00, 0x00, 0x00, 0x00, 0x00, 
  };

void setup() {
    myservo.attach(D8);
    myservo.write(90);
    
  
  Serial.begin(9600);
    
    display.init();
    display.clear();

    pinMode(sw, INPUT_PULLUP);
    pinMode (led,OUTPUT);
    pinMode(ECHO_PIN, INPUT);  
    pinMode(TRIG_PIN, OUTPUT);

    display.drawXbm(31 ,5 ,width,height,BT);
    display.display();

    WiFi.mode(WIFI_STA);
  // connect to wifi.
  WiFi.begin(WIFI_SSID, WIFI_PASSWORD);
  Serial.print("connecting");
  while (WiFi.status() != WL_CONNECTED) {
  Serial.print(".");
  delay(500);
  }
  Serial.println();
  Serial.print("connected: ");
  Serial.println(WiFi.localIP());
}

void(* resetFunc) (void) = 0;

void loop() {



    //Set font
    display.setFont(ArialMT_Plain_10);

      //หา dist
    digitalWrite(TRIG_PIN, HIGH);                
    delayMicroseconds(12);
    digitalWrite(TRIG_PIN, LOW);    
    unsigned long duration = pulseIn(ECHO_PIN, HIGH);  
    unsigned long dist = (0.034*duration)/2 ; 
    Serial.print("Ultrasonic ");
    Serial.print(dist);
    Serial.println(" cm");
    delay(200);

    






if (dist < 20) {
  display.clear();
          display.drawString(30, 25, String(".:WELCOME:."));
          display.display();

      for ( pos ; pos < 180 ; pos++) {
        myservo.write(pos);
        delay (15);
      }
      
      delay(1000);
     }
     
      if ((dist > 25) && (R0nad == 0)) {
         for (pos ; pos > 90 ; pos--) {
            myservo.write(pos);
            delay (15);
                  }
        }
     
     if (digitalRead(sw) == LOW) {
                for (pos ; pos > 0 ; pos--) {
                myservo.write(pos);
                delay (15);
  }
                  i++;
                R0nad++;
                Serial.println(i);
     }


  if (i >= 2) {
                for (pos ; pos < 90 ; pos++) {
                myservo.write(pos);
                delay (15);
  }
                i = 0;
                R0nad = 0;
  }











  
    


        unsigned long showTime = millis();

    //OLED 
        if (banana == 1) {
          display.clear();
          display.drawString(15, 25, String("Please wear a helmet."));
          display.display();
          Line_Notify(message);
          delay(5000);
          resetFunc();
          }
          
        if ((dist < 20) && ((showTime - previousTime) / 1000 != 0)) {
          display.clear();
          display.drawString(30, 25, String(".:WELCOME:."));
          display.display();
          }

        if ((showTime - previousTime) / 1000 == 1) {
          display.clear();
          }
    
    if ((dist < 20) && (r0und == 0)) {
      Start++;
      previousTime = showTime;
      Serial.println("Start...");
      r0und = 1;
    }

    if (dist > 25) {
      Start = 0;
      r0und = 0;
      display.clear();
      display.drawXbm(31 ,5 ,width,height,BT);
      display.display();
    }
      

      if(Start >= 1){
      Serial.print("setTime: ");
      Serial.print(setTime);
      Serial.print("   showTime: ");
      Serial.print(showTime); 
      Serial.print("   previousTime: ");
      Serial.print(previousTime); 
      Serial.print("   Time: ");
      Serial.println((showTime - previousTime) / 1000);
      Serial.println(" ");
            
            if((showTime - previousTime) / 1000 >= setTime)
            {
          Start = 0;
          digitalWrite(led, HIGH);
          Serial.println("LED ON");
          display.clear();
          banana = 1;
            }

                    }
    }

    void Line_Notify(String message) {
axTLS::WiFiClientSecure client; //กรณีข้ึน Error ให้ลบ axTLS:: ขา้งหนา้ทิ้ง
if (!client.connect("notify-api.line.me", 443)) {
Serial.println("connection failed");
return;
}
String req = "";
req += "POST /api/notify HTTP/1.1\r\n";
req += "Host: notify-api.line.me\r\n";
req += "Authorization: Bearer " + String(LINE_TOKEN) + "\r\n";
req += "Cache-Control: no-cache\r\n";
req += "User-Agent: ESP8266\r\n";
req += "Connection: close\r\n";
req += "Content-Type: application/x-www-form-urlencoded\r\n";
req += "Content-Length: " + String(String("message=" + message).length()) + "\r\n";
req += "\r\n";
req += "message=" + message;
// Serial.println(req);
client.print(req);
delay(20);
// Serial.println("-------------");
while(client.connected()) {
String line = client.readStringUntil('\n');
if (line == "\r") {
break;
}
//Serial.println(line);
}
// Serial.println("-------------");
}
